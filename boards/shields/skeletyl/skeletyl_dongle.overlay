#include "skeletyl.dtsi"

/ {
    chosen {
        zmk,kscan = &default_kscan;
    };

    default_kscan: kscan_0 {
        compatible = "zmk,kscan-mock";
        columns = <0>;
        rows = <0>;
        events = <0>;
    };
};